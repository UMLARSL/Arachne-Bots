//Sends coordinates to the spider from the spider_track python script and receives IR readings from the spider bot
//Written by Ben Sullivan
//Example Send: -./1,493,148,352,240,37+++
#include "EEPROM.h"
#include "cc1101.h"

#define LEDOUTPUT        4       // Connect led to digital pin 4
#define RFCHANNEL        0       // Let's use channel 0
#define SYNCWORD1        0xB5    // Synchronization word, high byte
#define SYNCWORD0        0x47    // Synchronization word, low byte
#define SOURCE_ADDR      4       // Sender address
#define DESTINATION_ADDR 5       // Receiver address

CC1101 cc1101;      // radio object
CCPACKET txPacket;  // packet object
byte count = 0;

unsigned char LSB, MSB;

int north, northEast, east, southEast, south, southWest, west, northWest;

/**
 * This function is called whenever a wireless packet is received
 */
void rfPacketReceived(void)
{
  CCPACKET packet;
    
  // Disable wireless reception interrupt
  detachInterrupt(0);
  if(cc1101.receiveData(&packet) > 0)
  {
    //Serial.println("PR");
    
    if (packet.crc_ok/* && packet.length > 1*/)
    {
      // The LED will toggle when a new packet is received
      digitalWrite(LEDOUTPUT, !digitalRead(LEDOUTPUT)); 
 
      int north = byte_parse (packet.data[1], packet.data[2]);
      int northEast = byte_parse (packet.data[3], packet.data[4]);
      int east = byte_parse (packet.data[5], packet.data[6]);
      int southEast = byte_parse (packet.data[7], packet.data[8]);
      int south = byte_parse (packet.data[9], packet.data[10]);
      int southWest = byte_parse (packet.data[11], packet.data[12]);
      int west = byte_parse (packet.data[13], packet.data[14]);
      int northWest = byte_parse (packet.data[15], packet.data[16]);
      //combine the received bytes
      
      //Serial.print("Sender: ");
      //Serial.println(packet.data[0]);
     *Serial.print ("N: ");
      Serial.print (north);;
      Serial.print(" NE: ");
      Serial.print(northEast);
      Serial.print(" E: ");
      Serial.print(east);
      Serial.print( "SE: ");
      Serial.println(southEast);
     /* Serial.print(" S: ");
      Serial.print(south);
      Serial.print(" SW: ");
      Serial.print (southWest);
      Serial.print(" W: ");
      Serial.println(west);
      Serial.print(" NW: ");
      Serial.println(northWest); */ 
      
      // packet.data[0];   // Our source address
      // packet.data[1];   // Self-incrementing value generated by the sender
      // packet.data[2];   // Self-incrementing value generated by the sender
      // ...
    }
  }

  // Enable wireless reception interrupt
  attachInterrupt(0, rfPacketReceived, FALLING);
}

void setup()
{
  // Setup LED output pin
  Serial.begin(38400);
  pinMode(LEDOUTPUT, OUTPUT);
  digitalWrite(LEDOUTPUT, LOW);

  // Init RF IC
  cc1101.init();
  cc1101.setCarrierFreq(CFREQ_915);//must set frequency to 915MHz, otherwise illegal in US
  cc1101.setChannel(RFCHANNEL, false);
  cc1101.setSyncWord(SYNCWORD1, SYNCWORD0, false);
  cc1101.setDevAddress(SOURCE_ADDR, false);

  // Let's disable address check for the current project so that our device
  // will receive packets even not addressed to it.
  //cc1101.disableAddressCheck();
  Serial.println("S");

  attachInterrupt(0, rfPacketReceived, FALLING);
}

void loop()
{
  
  //read_coordinates();
  
  //txPacket.length = 16;  // Let's send a single data byte plus the destination address

  // Data payload:
 // txPacket.data[0] = DESTINATION_ADDR;   // First data byte has to be the destination address
 // txPacket.data[1] = count++;            // Self-incrementing value 
 // txPacket.data[2] = count++;            // Self-incrementing value
 // txPacket.data[3] = count++;            // Self-incrementing value
 // txPacket.data[4] = count++;            // Self-incrementing value
 // txPacket.data[5] = count++;            // Self-incrementing value
 // cc1101.sendData(txPacket);             // Transmit packet
   
 // delay(1000);                           // Transmit every 5 seconds
  // For low-power applications replace "delay" by "panstamp.sleepWd(WDTO_8S)" for example
}

void read_coordinates()
{
	//check for correct number of bytes
	if(Serial.available() ){
		//check for start delimiter to packet
		Serial.findUntil("-./", "-./");
		txPacket.data[0] = (byte)Serial.parseInt();//receiver address
		txPacket.data[1] = SOURCE_ADDR;

		byte_conversion(Serial.parseInt());//x_r
		txPacket.data[2] = LSB;//stores least significant byte of x_r into packet
		txPacket.data[3] = MSB;//stores most significant byte of x_r into packet
			
		byte_conversion(Serial.parseInt());//y_r
		txPacket.data[4] = LSB;
		txPacket.data[5] = MSB;

		byte_conversion(Serial.parseInt());//x
		txPacket.data[6] = LSB;
		txPacket.data[7] = MSB;

		byte_conversion(Serial.parseInt());//y
		txPacket.data[8] = LSB;
		txPacket.data[9] = MSB;

		byte_conversion(Serial.parseInt());//phi
		txPacket.data[10] = LSB;
		txPacket.data[11] = MSB;

		byte_conversion(Serial.parseInt());//x_o
		txPacket.data[12] = LSB;
		txPacket.data[13] = MSB;

		byte_conversion(Serial.parseInt());//y_o
		txPacket.data[14] = LSB;
		txPacket.data[15] = MSB;  

		if( Serial.findUntil("+++", "+++")){
			send_coordinates();	
		}

		Serial.flush();
	}
}


void send_coordinates()
{
	//send data and report if it was properly sent and to which radio
	if(cc1101.sendData(txPacket)){
		//Serial.print("Sent to: ");
		//Serial.println(packet.data[0]);	
	}
	else{
		Serial.print("Failed to send to: ");
		Serial.println(txPacket.data[0]);
	}
}

void byte_conversion(int number)
{
	//store least significant byte of number
    LSB = number & 0xff;

    //store  most significant byte of number
    MSB = (number >> 8) & 0xff;
}

int byte_parse(unsigned char LSB, unsigned char MSB )
{
	return (int)word(MSB, LSB);
}
